## meta-blackhole/conf/layer.conf
```bitbake
# We have a conf and classes directory, append to BBPATH
BBPATH .= ":${LAYERDIR}"

# We have a recipes directory, add to BBFILES
BBFILES += "${LAYERDIR}/recipes-*/*/*.bb ${LAYERDIR}/recipes-*/*/*.bbappend"

BBFILE_COLLECTIONS += "blackhole-layer"
BBFILE_PATTERN_blackhole-layer := "^${LAYERDIR}/"
BBFILE_PRIORITY_blackhole-layer = "7"

BLACKHOLE_BASE := '${@os.path.normpath("${LAYERDIR}/../")}'
# Prevent current directory creeping into sstate objects. Otherwise, building
# in another TOPDIR will cause recipes using this variable to be rebuilt.
BLACKHOLE_BASE[vardepvalue] = 'meta-blackhole'

LICENSE_PATH += "${LAYERDIR}/licenses"
```
